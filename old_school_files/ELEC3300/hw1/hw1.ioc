# file: hw1.ioc
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Mcu.Family=STM32F1
Mcu.Name=STM32F103V(C-D-E)Tx
Mcu.Package=LQFP100
NVIC.PriorityGroup=NVIC_PRIORITYGROUP_4
OSC_IN.Mode=HSE-External-Oscillator
OSC_IN.Signal=RCC_OSC_IN
OSC_OUT.Mode=HSE-External-Oscillator
OSC_OUT.Signal=RCC_OSC_OUT
PA13.Mode=Serial_Wire
PA13.Signal=SYS_JTMS-SWDIO
PA14.Mode=Serial_Wire
PA14.Signal=SYS_JTCK-SWCLK
PC14-OSC32_IN.Mode=LSE-External-Oscillator
PC14-OSC32_IN.Signal=RCC_OSC32_IN
PC15-OSC32_OUT.Mode=LSE-External-Oscillator
PC15-OSC32_OUT.Signal=RCC_OSC32_OUT
ProjectManager.HeapSize=0x200
ProjectManager.StackSize=0x400
ProjectManager.TargetToolchain=STM32CubeIDE
RCC.AHBFreq_Value=72000000
RCC.APB1CLKDivider=RCC_HCLK_DIV2
RCC.APB1Freq_Value=36000000
RCC.APB1TimFreq_Value=72000000
RCC.APB2Freq_Value=72000000
RCC.APB2TimFreq_Value=72000000
RCC.HCLKFreq_Value=72000000
RCC.PLLMUL=RCC_PLL_MUL9
RCC.PLLSourceVirtual=RCC_PLLSOURCE_HSE
RCC.SYSCLKFreq_VALUE=72000000
RCC.SYSCLKSource=RCC_SYSCLKSOURCE_PLLCLK
RCC.USBFreq_Value=72000000
board=custom

// file: Core/Src/main.c
/* USER CODE BEGIN Header */
/**
  ******************************************************************************
	ELEC 3300 HW1 main.c
  ******************************************************************************
  */
/* USER CODE END Header */
#include "main.h"

/* USER CODE BEGIN PD */
#define MAX 8
/* USER CODE END PD */

/* USER CODE BEGIN PV */
int i, j;
float x;
double y;
int ANDresult = 0;
int ORresult = 0;
int XORresult = 0;

// Please fill the array stdid with your Student ID
// Say if your student ID is 20123456, array will be
// int stdid[8] = {2,0,1,2,3,4,5,6};
int stdid[8] = {2,0,7,4,0,5,8,9};
int swapid[8];
int oddid[8];
/* USER CODE END PV */

void SystemClock_Config(void);
static void MX_GPIO_Init(void);

int main(void)
{

  /* MCU Configuration--------------------------------------------------------*/

  /* Reset of all peripherals, Initializes the Flash interface and the Systick. */
  HAL_Init();

  /* Configure the system clock */
  SystemClock_Config();

  /* Initialize all configured peripherals */
  MX_GPIO_Init();
  /* USER CODE BEGIN 2 */
  int counter = 0;
  int sum = 0;

  i = 0x20740589;
  // i is called Binary Coded Decimal (BCD) representation of your student ID
  // i.e. i = 0x20123456

  j = 0x98504702;
  // j is the reverse Binary Coded Decimal (BCD) representation of your student ID
  // i.e. j = 0x65432102

  x = 2074.0589;
  // x is a decimal floating point number of your student ID with
  // first 4 digits before the decimal point and last 4 digits after the decimal point
  //  x = 2012.3456;

  y = 20740589.98504702;
  // y is a decimal floating point number of your student ID with
  // all 8 digits before the decimal point and reverse 8 digits after the decimal point
  //y = 20123456.65432102;

  for (counter=0; counter<MAX ; counter++) {
    // write ONE line of code to store your stdid reversely and store it in swapid
    // Say if your int stdid[8] = {2,0,1,2,3,4,5,6};
    // Your int swapid[8] will be finally = {6,5,4,3,2,1,0,2} after the for loop.
	  swapid[MAX-counter-1]=stdid[counter];

    // write ONE line of code to store check if your stdid[?] is odd and store it in oddid
    // Say if your int stdid[8] = {2,0,1,2,3,4,5,6};
    // Your int oddid[8] will be finally = {0,0,1,0,1,0,1,0} after the for loop
	 oddid[counter] = stdid[counter]%2 != 0 ? 1 : 0;

    // Write ONE line to sum the stdid digits
    // AFTER the for loop, sum should return the summation of your student id digits.
	 sum+=stdid[counter];

  };

  __asm("NOP"); // Check Point for Question 2.

  // Write ONE line of code to perform bitwise AND between i and j, and store it in ANDresult
  ANDresult = i & j;

  // Write ONE line of code to perform bitwise OR between i and j, and store it in ORresult
  ORresult = i | j;

  // Write ONE line of code to perform bitwise XOR between i and j, and store it in XORresult
  XORresult = i ^ j;

  __asm("NOP"); // Check Point for Question 4 and 5.

  __asm("MOV  R1, 0x0589"); // Make R1 = i
  __asm("MOVT R1, 0x2074"); // Replace the corresponding digits according to your SID

  __asm("MOV  R2, 0x4702"); // Make R2 = j
  __asm("MOVT R2, 0x9850"); // Replace the corresponding digits according to your SID

  __asm("MOV  R0, 0x0");    // Make R0 = 0

  __asm("ADDS R3, R0, R0");
  // Look at the Hex value of xpsr register **AFTER** addition.
  // What are the statuses of the N, Z, C, V flags **AFTER** addition ?
  // Please explain the result.

  __asm("NOP"); // Check Point for Question 6

  __asm("ADDS R3, R1, R2"); // i + j
  // Look at the Hex value of xpsr register **AFTER** addition.
  // What are the statuses of C and V flags **AFTER** addition ?
  // Please explain your result **IN DETAIL** with respect to your value in R3 to R1 and R2.

  __asm("NOP"); // Check Point for Question 7

  __asm("ADDS R3, R0, R0");
  // Just guess what I want to do in here ? :-P.

  __asm("SUBS R3, R1, R2"); // i - j
  // Look at the Hex value of xpsr register **AFTER** addition.
  // What are the statuses of C and V flags **AFTER** addition ?
  // Please explain your result in **IN DETAIL** with respect to your value in R3 to R1 and R2.

  __asm("NOP"); // Check Point for Question 8

  /* USER CODE END 2 */

  /* Infinite loop */
  while (1)
  {

    /* USER CODE BEGIN 3 */
	__asm("NOP"); // While Loop
  }
  /* USER CODE END 3 */
}

void SystemClock_Config(void)
{
  RCC_OscInitTypeDef RCC_OscInitStruct = {0};
  RCC_ClkInitTypeDef RCC_ClkInitStruct = {0};

  /** Initializes the RCC Oscillators according to the specified parameters
  * in the RCC_OscInitTypeDef structure.
  */
  RCC_OscInitStruct.OscillatorType = RCC_OSCILLATORTYPE_HSE;
  RCC_OscInitStruct.HSEState = RCC_HSE_ON;
  RCC_OscInitStruct.HSEPredivValue = RCC_HSE_PREDIV_DIV1;
  RCC_OscInitStruct.HSIState = RCC_HSI_ON;
  RCC_OscInitStruct.PLL.PLLState = RCC_PLL_ON;
  RCC_OscInitStruct.PLL.PLLSource = RCC_PLLSOURCE_HSE;
  RCC_OscInitStruct.PLL.PLLMUL = RCC_PLL_MUL9;
  if (HAL_RCC_OscConfig(&RCC_OscInitStruct) != HAL_OK)
  {
    Error_Handler();
  }

  /** Initializes the CPU, AHB and APB buses clocks
  */
  RCC_ClkInitStruct.ClockType = RCC_CLOCKTYPE_HCLK|RCC_CLOCKTYPE_SYSCLK
                              |RCC_CLOCKTYPE_PCLK1|RCC_CLOCKTYPE_PCLK2;
  RCC_ClkInitStruct.SYSCLKSource = RCC_SYSCLKSOURCE_PLLCLK;
  RCC_ClkInitStruct.AHBCLKDivider = RCC_SYSCLK_DIV1;
  RCC_ClkInitStruct.APB1CLKDivider = RCC_HCLK_DIV2;
  RCC_ClkInitStruct.APB2CLKDivider = RCC_HCLK_DIV1;

  if (HAL_RCC_ClockConfig(&RCC_ClkInitStruct, FLASH_LATENCY_2) != HAL_OK)
  {
    Error_Handler();
  }
}

static void MX_GPIO_Init(void)
{

  /* GPIO Ports Clock Enable */
  __HAL_RCC_GPIOC_CLK_ENABLE();
  __HAL_RCC_GPIOA_CLK_ENABLE();
  __HAL_RCC_GPIOB_CLK_ENABLE();

}

void Error_Handler(void)
{
  __disable_irq();
  while (1)
  {
  }
}
